## config/boards/shields/mlego_m66_rev4/Kconfig.defconfig
```kconfig
if SHIELD_MLEGO_M66_REV4 || SHIELD_ST7735 || SHIELD_LS011B7DH03 || SHIELD_LS013B7DH03 || SHIELD_LS013B7DH05 || SHIELD_WEACT_EINK_154 || SHIELD_WEACT_EINK_213 || SHIELD_MLEGO_M66_REV4_RP2040

config ZMK_KEYBOARD_NAME
    default "minilair" 

config SPI
	default y

endif # MLEGO_M66_REV4
```

## config/boards/shields/mlego_m66_rev4/Kconfig.shield
```kconfig
config  SHIELD_MLEGO_M66_REV4
   def_bool $(shields_list_contains,mlego_m66_rev4)
```
